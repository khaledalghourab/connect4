// SpaceInvaders.c
// Runs on LM4F120/TM4C123
// Jonathan Valvano and Daniel Valvano
// This is a starter project for the edX Lab 15
// In order for other students to play your game
// 1) You must leave the hardware configuration as defined
// 2) You must not add/remove any files from the project
// 3) You must add your code only this this C file
// I.e., if you wish to use code from sprite.c or sound.c, move that code in this file
// 4) It must compile with the 32k limit of the free Keil

// April 10, 2014
// http://www.spaceinvaders.de/
// sounds at http://www.classicgaming.cc/classics/spaceinvaders/sounds.php
// http://www.classicgaming.cc/classics/spaceinvaders/playguide.php
/* This example accompanies the books
   "Embedded Systems: Real Time Interfacing to Arm Cortex M Microcontrollers",
   ISBN: 978-1463590154, Jonathan Valvano, copyright (c) 2013

   "Embedded Systems: Introduction to Arm Cortex M Microcontrollers",
   ISBN: 978-1469998749, Jonathan Valvano, copyright (c) 2013

 Copyright 2014 by Jonathan W. Valvano, valvano@mail.utexas.edu
    You may use, edit, run or distribute this file
    as long as the above copyright notice remains
 THIS SOFTWARE IS PROVIDED "AS IS".  NO WARRANTIES, WHETHER EXPRESS, IMPLIED
 OR STATUTORY, INCLUDING, BUT NOT LIMITED TO, IMPLIED WARRANTIES OF
 MERCHANTABILITY AND FITNESS FOR A PARTICULAR PURPOSE APPLY TO THIS SOFTWARE.
 VALVANO SHALL NOT, IN ANY CIRCUMSTANCES, BE LIABLE FOR SPECIAL, INCIDENTAL,
 OR CONSEQUENTIAL DAMAGES, FOR ANY REASON WHATSOEVER.
 For more information about my classes, my research, and my books, see
 http://users.ece.utexas.edu/~valvano/
 */
// ******* Required Hardware I/O connections*******************
// Slide pot pin 1 connected to ground
// Slide pot pin 2 connected to PE2/AIN1
// Slide pot pin 3 connected to +3.3V 
// fire button connected to PE0
// special weapon fire button connected to PE1
// 8*R resistor DAC bit 0 on PB0 (least significant bit)
// 4*R resistor DAC bit 1 on PB1
// 2*R resistor DAC bit 2 on PB2
// 1*R resistor DAC bit 3 on PB3 (most significant bit)
// LED on PB4
// LED on PB5

// Blue Nokia 5110
// ---------------
// Signal        (Nokia 5110) LaunchPad pin
// Reset         (RST, pin 1) connected to PA7
// SSI0Fss       (CE,  pin 2) connected to PA3
// Data/Command  (DC,  pin 3) connected to PA6
// SSI0Tx        (Din, pin 4) connected to PA5
// SSI0Clk       (Clk, pin 5) connected to PA2
// 3.3V          (Vcc, pin 6) power
// back light    (BL,  pin 7) not connected, consists of 4 white LEDs which draw ~80mA total
// Ground        (Gnd, pin 8) ground

// Red SparkFun Nokia 5110 (LCD-10168)
// -----------------------------------
// Signal        (Nokia 5110) LaunchPad pin
// 3.3V          (VCC, pin 1) power
// Ground        (GND, pin 2) ground
// SSI0Fss       (SCE, pin 3) connected to PA3
// Reset         (RST, pin 4) connected to PA7
// Data/Command  (D/C, pin 5) connected to PA6
// SSI0Tx        (DN,  pin 6) connected to PA5
// SSI0Clk       (SCLK, pin 7) connected to PA2
// back light    (LED, pin 8) not connected, consists of 4 white LEDs which draw ~80mA total

#include "..//tm4c123gh6pm.h"
#include "Nokia5110.h"
#include "Random.h"
#include "TExaS.h"
#include <stdbool.h>
#include <math.h>
#include <stdlib.h>
#include <string.h>

void DisableInterrupts(void); // Disable interrupts
void EnableInterrupts(void);  // Enable interrupts
void Timer2_Init(unsigned long period);
void Delay100ms(unsigned long count);
void result (unsigned char row,unsigned char col,int player);// time delay in 0.1 seconds
void player_1_add(unsigned char x);
void player_2_add(unsigned char x);
void print_board(char col, char row , int player);
void win_mess(int player);
unsigned long TimerCount;
unsigned long Semaphore;
unsigned char uart;
void WaitForInterrupt(void);
unsigned char UART_InChar(void);
void UART_OutChar(unsigned char data);
void UART_Init(void);
void bor3y (unsigned char row,unsigned char col);
// *************************** Images ***************************
// enemy ship that starts at the top of the screen (arms/mouth closed)
// width=16 x height=10
/*const unsigned char White[] ={
 0x42, 0x4D, 0x96, 0x00, 0x00, 0x00, 0x00, 0x00, 0x00, 0x00, 0x76, 0x00, 0x00, 0x00, 0x28, 0x00, 0x00, 0x00, 0x08, 0x00, 0x00, 0x00, 0x08, 0x00, 0x00, 0x00, 0x01, 0x00, 0x04, 0x00, 0x00, 0x00,
 0x00, 0x00, 0x20, 0x00, 0x00, 0x00, 0x00, 0x00, 0x00, 0x00, 0x00, 0x00, 0x00, 0x00, 0x00, 0x00, 0x00, 0x00, 0x00, 0x00, 0x00, 0x00, 0x00, 0x00, 0x00, 0x00, 0x00, 0x00, 0x80, 0x00, 0x00, 0x80,
 0x00, 0x00, 0x00, 0x80, 0x80, 0x00, 0x80, 0x00, 0x00, 0x00, 0x80, 0x00, 0x80, 0x00, 0x80, 0x80, 0x00, 0x00, 0x80, 0x80, 0x80, 0x00, 0xC0, 0xC0, 0xC0, 0x00, 0x00, 0x00, 0xFF, 0x00, 0x00, 0xFF,
 0x00, 0x00, 0x00, 0xFF, 0xFF, 0x00, 0xFF, 0x00, 0x00, 0x00, 0xFF, 0x00, 0xFF, 0x00, 0xFF, 0xFF, 0x00, 0x00, 0xFF, 0xFF, 0xFF, 0x00, 0xFF, 0xFF, 0xFF, 0xFF, 0xFF, 0x00, 0x00, 0xFF, 0xF0, 0x00,
 0x00, 0x0F, 0x00, 0x00, 0x00, 0x00, 0x00, 0x00, 0x00, 0x00, 0x00, 0x00, 0x00, 0x00, 0xF0, 0x00, 0x00, 0x0F, 0xFF, 0x00, 0x00, 0xFF, 0xFF,

};*/
const unsigned char two2[] ={
 0x42, 0x4D, 0x8E, 0x00, 0x00, 0x00, 0x00, 0x00, 0x00, 0x00, 0x76, 0x00, 0x00, 0x00, 0x28, 0x00, 0x00, 0x00, 0x06, 0x00, 0x00, 0x00, 0x06, 0x00, 0x00, 0x00, 0x01, 0x00, 0x04, 0x00, 0x00, 0x00,
 0x00, 0x00, 0x18, 0x00, 0x00, 0x00, 0x00, 0x00, 0x00, 0x00, 0x00, 0x00, 0x00, 0x00, 0x00, 0x00, 0x00, 0x00, 0x00, 0x00, 0x00, 0x00, 0x00, 0x00, 0x00, 0x00, 0x00, 0x00, 0x80, 0x00, 0x00, 0x80,
 0x00, 0x00, 0x00, 0x80, 0x80, 0x00, 0x80, 0x00, 0x00, 0x00, 0x80, 0x00, 0x80, 0x00, 0x80, 0x80, 0x00, 0x00, 0x80, 0x80, 0x80, 0x00, 0xC0, 0xC0, 0xC0, 0x00, 0x00, 0x00, 0xFF, 0x00, 0x00, 0xFF,
 0x00, 0x00, 0x00, 0xFF, 0xFF, 0x00, 0xFF, 0x00, 0x00, 0x00, 0xFF, 0x00, 0xFF, 0x00, 0xFF, 0xFF, 0x00, 0x00, 0xFF, 0xFF, 0xFF, 0x00, 0x00, 0x00, 0x00, 0x00, 0x07, 0x77, 0x70, 0x00, 0x07, 0x00,
 0x70, 0x00, 0x07, 0x00, 0x70, 0x00, 0x07, 0x77, 0x70, 0x00, 0x00, 0x00, 0x00, 0x00, 0xFF,

};
const unsigned char un2[] ={
 0x42, 0x4D, 0x8E, 0x00, 0x00, 0x00, 0x00, 0x00, 0x00, 0x00, 0x76, 0x00, 0x00, 0x00, 0x28, 0x00, 0x00, 0x00, 0x06, 0x00, 0x00, 0x00, 0x06, 0x00, 0x00, 0x00, 0x01, 0x00, 0x04, 0x00, 0x00, 0x00,
 0x00, 0x00, 0x18, 0x00, 0x00, 0x00, 0x00, 0x00, 0x00, 0x00, 0x00, 0x00, 0x00, 0x00, 0x00, 0x00, 0x00, 0x00, 0x00, 0x00, 0x00, 0x00, 0x00, 0x00, 0x00, 0x00, 0x00, 0x00, 0x80, 0x00, 0x00, 0x80,
 0x00, 0x00, 0x00, 0x80, 0x80, 0x00, 0x80, 0x00, 0x00, 0x00, 0x80, 0x00, 0x80, 0x00, 0x80, 0x80, 0x00, 0x00, 0x80, 0x80, 0x80, 0x00, 0xC0, 0xC0, 0xC0, 0x00, 0x00, 0x00, 0xFF, 0x00, 0x00, 0xFF,
 0x00, 0x00, 0x00, 0xFF, 0xFF, 0x00, 0xFF, 0x00, 0x00, 0x00, 0xFF, 0x00, 0xFF, 0x00, 0xFF, 0xFF, 0x00, 0x00, 0xFF, 0xFF, 0xFF, 0x00, 0x00, 0x00, 0x00, 0x00, 0x00, 0x77, 0x00, 0x00, 0x0F, 0xFF,
 0xF0, 0x00, 0x0F, 0xFF, 0xF0, 0x00, 0x00, 0x77, 0x00, 0x00, 0x00, 0x00, 0x00, 0x00, 0xFF,

};



const unsigned char select[] ={
 0x42, 0x4D, 0x8E, 0x00, 0x00, 0x00, 0x00, 0x00, 0x00, 0x00, 0x76, 0x00, 0x00, 0x00, 0x28, 0x00, 0x00, 0x00, 0x06, 0x00, 0x00, 0x00, 0x06, 0x00, 0x00, 0x00, 0x01, 0x00, 0x04, 0x00, 0x00, 0x00,
 0x00, 0x00, 0x18, 0x00, 0x00, 0x00, 0xC4, 0x0E, 0x00, 0x00, 0xC4, 0x0E, 0x00, 0x00, 0x00, 0x00, 0x00, 0x00, 0x00, 0x00, 0x00, 0x00, 0x00, 0x00, 0x00, 0x00, 0x00, 0x00, 0x80, 0x00, 0x00, 0x80,
 0x00, 0x00, 0x00, 0x80, 0x80, 0x00, 0x80, 0x00, 0x00, 0x00, 0x80, 0x00, 0x80, 0x00, 0x80, 0x80, 0x00, 0x00, 0x80, 0x80, 0x80, 0x00, 0xC0, 0xC0, 0xC0, 0x00, 0x00, 0x00, 0xFF, 0x00, 0x00, 0xFF,
 0x00, 0x00, 0x00, 0xFF, 0xFF, 0x00, 0xFF, 0x00, 0x00, 0x00, 0xFF, 0x00, 0xFF, 0x00, 0xFF, 0xFF, 0x00, 0x00, 0xFF, 0xFF, 0xFF, 0x00, 0x44, 0x44, 0x44, 0x00, 0x44, 0x44, 0x44, 0x00, 0x44, 0x44,
 0x44, 0x00, 0x44, 0x44, 0x44, 0x00, 0x44, 0x44, 0x44, 0x00, 0x44, 0x44, 0x44, 0x00, 0xFF,

};




const unsigned char grid[] ={
 0x42, 0x4D, 0xB6, 0x05, 0x00, 0x00, 0x00, 0x00, 0x00, 0x00, 0x76, 0x00, 0x00, 0x00, 0x28, 0x00, 0x00, 0x00, 0x38, 0x00, 0x00, 0x00, 0x30, 0x00, 0x00, 0x00, 0x01, 0x00, 0x04, 0x00, 0x00, 0x00,
 0x00, 0x00, 0x40, 0x05, 0x00, 0x00, 0xC4, 0x0E, 0x00, 0x00, 0xC4, 0x0E, 0x00, 0x00, 0x00, 0x00, 0x00, 0x00, 0x00, 0x00, 0x00, 0x00, 0x00, 0x00, 0x00, 0x00, 0x00, 0x00, 0x80, 0x00, 0x00, 0x80,
 0x00, 0x00, 0x00, 0x80, 0x80, 0x00, 0x80, 0x00, 0x00, 0x00, 0x80, 0x00, 0x80, 0x00, 0x80, 0x80, 0x00, 0x00, 0x80, 0x80, 0x80, 0x00, 0xC0, 0xC0, 0xC0, 0x00, 0x00, 0x00, 0xFF, 0x00, 0x00, 0xFF,
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 0xFF, 0xFF, 0xFF, 0xFF, 0xFF, 0xFF, 0xFF, 0xFF, 0xFF, 0xFF, 0xFF, 0xFF, 0xFF, 0xFF, 0xFF, 0xFF, 0xFF, 0xFF, 0xFF, 0xFF, 0xFF, 0xFF, 0xFF,

};



const unsigned char cover2[] ={
 0x42, 0x4D, 0xB6, 0x08, 0x00, 0x00, 0x00, 0x00, 0x00, 0x00, 0x76, 0x00, 0x00, 0x00, 0x28, 0x00, 0x00, 0x00, 0x54, 0x00, 0x00, 0x00, 0x30, 0x00, 0x00, 0x00, 0x01, 0x00, 0x04, 0x00, 0x00, 0x00,
 0x00, 0x00, 0x40, 0x08, 0x00, 0x00, 0xC4, 0x0E, 0x00, 0x00, 0xC4, 0x0E, 0x00, 0x00, 0x00, 0x00, 0x00, 0x00, 0x00, 0x00, 0x00, 0x00, 0x00, 0x00, 0x00, 0x00, 0x00, 0x00, 0x80, 0x00, 0x00, 0x80,
 0x00, 0x00, 0x00, 0x80, 0x80, 0x00, 0x80, 0x00, 0x00, 0x00, 0x80, 0x00, 0x80, 0x00, 0x80, 0x80, 0x00, 0x00, 0x80, 0x80, 0x80, 0x00, 0xC0, 0xC0, 0xC0, 0x00, 0x00, 0x00, 0xFF, 0x00, 0x00, 0xFF,
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 0x00, 0x00, 0x00, 0x00, 0x00, 0x00, 0x00, 0x00, 0x00, 0x00, 0x00, 0x00, 0x00, 0x00, 0x00, 0x00, 0x00, 0x00, 0x00, 0x00, 0x00, 0x00, 0xFF,

};









const unsigned char White[] ={
 0x42, 0x4D, 0x96, 0x00, 0x00, 0x00, 0x00, 0x00, 0x00, 0x00, 0x76, 0x00, 0x00, 0x00, 0x28, 0x00, 0x00, 0x00, 0x08, 0x00, 0x00, 0x00, 0x08, 0x00, 0x00, 0x00, 0x01, 0x00, 0x04, 0x00, 0x00, 0x00,
 0x00, 0x00, 0x20, 0x00, 0x00, 0x00, 0x00, 0x00, 0x00, 0x00, 0x00, 0x00, 0x00, 0x00, 0x00, 0x00, 0x00, 0x00, 0x00, 0x00, 0x00, 0x00, 0x00, 0x00, 0x00, 0x00, 0x00, 0x00, 0x80, 0x00, 0x00, 0x80,
 0x00, 0x00, 0x00, 0x80, 0x80, 0x00, 0x80, 0x00, 0x00, 0x00, 0x80, 0x00, 0x80, 0x00, 0x80, 0x80, 0x00, 0x00, 0x80, 0x80, 0x80, 0x00, 0xC0, 0xC0, 0xC0, 0x00, 0x00, 0x00, 0xFF, 0x00, 0x00, 0xFF,
 0x00, 0x00, 0x00, 0xFF, 0xFF, 0x00, 0xFF, 0x00, 0x00, 0x00, 0xFF, 0x00, 0xFF, 0x00, 0xFF, 0xFF, 0x00, 0x00, 0xFF, 0xFF, 0xFF, 0x00, 0x00, 0x00, 0x00, 0x00, 0x00, 0xFF, 0xFF, 0x00, 0x0F, 0x00,
 0x00, 0xF0, 0x0F, 0x00, 0x00, 0xF0, 0x0F, 0x00, 0x00, 0xF0, 0x0F, 0x00, 0x00, 0xF0, 0x00, 0xFF, 0xFF, 0x00, 0x00, 0x00, 0x00, 0x00, 0xFF,

};

const unsigned char black[] ={
 0x42, 0x4D, 0x96, 0x00, 0x00, 0x00, 0x00, 0x00, 0x00, 0x00, 0x76, 0x00, 0x00, 0x00, 0x28, 0x00, 0x00, 0x00, 0x08, 0x00, 0x00, 0x00, 0x08, 0x00, 0x00, 0x00, 0x01, 0x00, 0x04, 0x00, 0x00, 0x00,
 0x00, 0x00, 0x20, 0x00, 0x00, 0x00, 0x00, 0x00, 0x00, 0x00, 0x00, 0x00, 0x00, 0x00, 0x00, 0x00, 0x00, 0x00, 0x00, 0x00, 0x00, 0x00, 0x00, 0x00, 0x00, 0x00, 0x00, 0x00, 0x80, 0x00, 0x00, 0x80,
 0x00, 0x00, 0x00, 0x80, 0x80, 0x00, 0x80, 0x00, 0x00, 0x00, 0x80, 0x00, 0x80, 0x00, 0x80, 0x80, 0x00, 0x00, 0x80, 0x80, 0x80, 0x00, 0xC0, 0xC0, 0xC0, 0x00, 0x00, 0x00, 0xFF, 0x00, 0x00, 0xFF,
 0x00, 0x00, 0x00, 0xFF, 0xFF, 0x00, 0xFF, 0x00, 0x00, 0x00, 0xFF, 0x00, 0xFF, 0x00, 0xFF, 0xFF, 0x00, 0x00, 0xFF, 0xFF, 0xFF, 0x00, 0x00, 0x00, 0x00, 0x00, 0x00, 0x00, 0x00, 0x00, 0x00, 0xFF,
 0xFF, 0x00, 0x0F, 0xFF, 0xFF, 0xF0, 0x0F, 0xFF, 0xFF, 0xF0, 0x00, 0xFF, 0xFF, 0x00, 0x00, 0x00, 0x00, 0x00, 0x00, 0x00, 0x00, 0x00, 0xFF,

};
const unsigned char uny[] ={
 0x42, 0x4D, 0x8E, 0x00, 0x00, 0x00, 0x00, 0x00, 0x00, 0x00, 0x76, 0x00, 0x00, 0x00, 0x28, 0x00, 0x00, 0x00, 0x06, 0x00, 0x00, 0x00, 0x06, 0x00, 0x00, 0x00, 0x01, 0x00, 0x04, 0x00, 0x00, 0x00,
 0x00, 0x00, 0x18, 0x00, 0x00, 0x00, 0x00, 0x00, 0x00, 0x00, 0x00, 0x00, 0x00, 0x00, 0x00, 0x00, 0x00, 0x00, 0x00, 0x00, 0x00, 0x00, 0x00, 0x00, 0x00, 0x00, 0x00, 0x00, 0x80, 0x00, 0x00, 0x80,
 0x00, 0x00, 0x00, 0x80, 0x80, 0x00, 0x80, 0x00, 0x00, 0x00, 0x80, 0x00, 0x80, 0x00, 0x80, 0x80, 0x00, 0x00, 0x80, 0x80, 0x80, 0x00, 0xC0, 0xC0, 0xC0, 0x00, 0x00, 0x00, 0xFF, 0x00, 0x00, 0xFF,
 0x00, 0x00, 0x00, 0xFF, 0xFF, 0x00, 0xFF, 0x00, 0x00, 0x00, 0xFF, 0x00, 0xFF, 0x00, 0xFF, 0xFF, 0x00, 0x00, 0xFF, 0xFF, 0xFF, 0x00, 0xFF, 0x00, 0xFF, 0x00, 0x00, 0x00, 0x0F, 0x00, 0x00, 0x00,
 0x00, 0x00, 0x00, 0x00, 0x00, 0x00, 0xF0, 0x00, 0x0F, 0x00, 0xFF, 0x00, 0x0F, 0x00, 0xFF,

};


unsigned int row=0;
unsigned int coulmn=0;


unsigned char empty[6][7]={0};

unsigned char player_1[6][7]={0};
unsigned char player_2[6][7]={0};
unsigned char mode=0;
char rin=0,rout=0;
unsigned int row_check;
unsigned int col_check;
unsigned char win=0;
unsigned int c=0;
unsigned int x=0;
unsigned int rod;
unsigned int win_rod;
volatile unsigned long FallingEdges = 0;
unsigned char chose_col=0;
unsigned char last_play=0;
unsigned char turn=0;
unsigned char safe=0;
unsigned char seed=0;
unsigned char clear=0;
signed int check;
// enemy ship that starts at the top of the screen (arms/mouth open)
// width=16 x height=10

// *************************** Capture image dimensions out of BMP**********
void EdgeCounter_Init(void){   unsigned long volatile delay;                       
    SYSCTL_RCGC2_R |= 0x00000020; // (a) activate clock for port F
  delay = SYSCTL_RCGC2_R;
  GPIO_PORTF_LOCK_R = 0x4C4F434B; // unlock GPIO Port F
  GPIO_PORTF_CR_R = 0x11;         // allow changes to PF4,0
  GPIO_PORTF_DIR_R &= ~0x11;    // (c) make PF4,0 in (built-in button)
  GPIO_PORTF_AFSEL_R &= ~0x11;  //     disable alt funct on PF4,0
  GPIO_PORTF_DEN_R |= 0x11;     //     enable digital I/O on PF4,0
  GPIO_PORTF_PCTL_R &= ~0x000F000F; //  configure PF4,0 as GPIO
  GPIO_PORTF_AMSEL_R &= ~0x11;  //     disable analog functionality on PF4,0
  GPIO_PORTF_PUR_R |= 0x11;     //     enable weak pull-up on PF4,0
  GPIO_PORTF_IS_R &= ~0x11;     // (d) PF4,PF0 is edge-sensitive
  GPIO_PORTF_IBE_R &= ~0x11;    //     PF4,PF0 is not both edges
  GPIO_PORTF_IEV_R &= ~0x11;    //     PF4,PF0 falling edge event
  GPIO_PORTF_ICR_R = 0x11;      // (e) clear flags 4,0
  GPIO_PORTF_IM_R |= 0x11;      // (f) arm interrupt on PF4,PF0
  NVIC_PRI7_R = (NVIC_PRI7_R&0xFF00FFFF)|0x00400000; // (g) priority 2
  NVIC_EN0_R = 0x40000000;      // (h) enable interrupt 30 in NVIC
  EnableInterrupts();           // (i) Clears the I bit
}
void GPIOPortF_Handler(void){
 switch(mode)
	{
		case 0:
			
	
				 if(GPIO_PORTF_RIS_R&0x01){
					  Delay100ms(2);
						GPIO_PORTF_ICR_R = 0x01;  // acknowledge flag0
					 mode=2;
					 while(rin==rout)
					 { srand(seed);
					 rin = rand()%9;
						UART_OutChar(rin='0');
						rout= UART_InChar();
						 seed++;
					 }
					if (rin>rout)
						turn=0;
					if (rin<rout)
						turn=1;
					while((UART1_FR_R&UART_FR_RXFE) == 0)clear=UART1_DR_R & ~(0xFF);
				 }
				  if(GPIO_PORTF_RIS_R&0x10){
					  Delay100ms(2);
    GPIO_PORTF_ICR_R = 0x10;  // acknowledge flag0
					 mode=1;
				 }
					break;
		case 2:
	if(GPIO_PORTF_RIS_R&0x01){ 
				 chose_col++;
		 if(chose_col==7){
			 chose_col=0;
		
			 	Nokia5110_PrintBMP(13+((6)*8), 6, select,7);
		 }
		 if(turn==0)
	{
	
			if(empty[5][chose_col]==1){
		 Nokia5110_PrintBMP(13+(chose_col*8), 6, two2,5);
		Nokia5110_DisplayBuffer();}
		if(empty[5][chose_col-1]==1){
		Nokia5110_PrintBMP(13+((chose_col-1)*8), 6, select,7);}
	Nokia5110_DisplayBuffer();


		
		
  }	
		 // SW2 touch
		 Delay100ms(2);
    GPIO_PORTF_ICR_R = 0x01;  // acknowledge flag0
   
		
	
	
  }
  if(GPIO_PORTF_RIS_R&0x10){
Delay100ms(2);		// SW1 touch
    GPIO_PORTF_ICR_R = 0x10;  // acknowledge flag4
  if(turn==0&&empty[5][chose_col]==1)
	{
		
		Nokia5110_PrintBMP(13+(chose_col*8), 6, select,7);
		player_1_add(chose_col);
	    Nokia5110_DisplayBuffer(); 

		turn=1;
		UART_OutChar(chose_col+1+'0');
		chose_col=0;
		 Nokia5110_DisplayBuffer(); 
  }}
	break;
		case 1:
			 if(GPIO_PORTF_RIS_R&0x01){ 
				 chose_col++;
		 if(chose_col==7){
			 chose_col=0;
		
			 	Nokia5110_PrintBMP(13+((6)*8), 6, select,7);
		 }
		 if(turn==0)
	{
	
		if(empty[5][chose_col]==1){
		 Nokia5110_PrintBMP(13+(chose_col*8), 6, two2,5);
		Nokia5110_DisplayBuffer();}
		if(empty[5][chose_col-1]==1){
		Nokia5110_PrintBMP(13+((chose_col-1)*8), 6, select,7);}
	Nokia5110_DisplayBuffer();

		
		
  }	
		 // SW2 touch
		 Delay100ms(2);
    GPIO_PORTF_ICR_R = 0x01;  // acknowledge flag0
   
		
	
	
  }
  if(GPIO_PORTF_RIS_R&0x10){
Delay100ms(2);		// SW1 touch
    GPIO_PORTF_ICR_R = 0x10;
		// acknowledge flag4
		//recheck lw hbel
  if(turn==0&&empty[5][chose_col]==1)
	{
		
		Nokia5110_PrintBMP(13+(chose_col*8), 6, select,7);
		coulmn=chose_col;
		player_1_add(chose_col);
	    Nokia5110_DisplayBuffer(); 

		turn=1;
		
		chose_col=0;
  }}
			break;
		default:
			break;
	}
}

int main(void){
  EdgeCounter_Init();
	 UART_Init();
//all screen is empty
    	
			
  TExaS_Init(SSI0_Real_Nokia5110_Scope);  // set system clock to 80 MHz
  Random_Init(1);
  Nokia5110_Init();
	DisableInterrupts();
	for ( row = 0; row<=5; row++){
  for ( coulmn = 0; coulmn <= 6; coulmn++){
    empty[row][coulmn] = 1;}}
 
Nokia5110_ClearBuffer();	 
	Nokia5110_DisplayBuffer();
  Nokia5110_SetCursor(0,0);
			Nokia5110_OutString("instructions:use switch 2 to move and swich 1 to insert");		// draw buffer
		Delay100ms(50);
		Nokia5110_ClearBuffer();
		EnableInterrupts();
			while(mode==0){
		Nokia5110_PrintBMP(0,47, cover2,1);
		   Nokia5110_DisplayBuffer();
			seed++;}
			Nokia5110_ClearBuffer();	 
Nokia5110_PrintBMP(12, 47, grid,13);
			DisableInterrupts();
if (mode==2)
{
	
	if (rin>rout)
						turn=0;
					if (rin<rout)
						turn=1;
	
}
EnableInterrupts();
	
	


  Nokia5110_DisplayBuffer();     // draw buffer

  //Delay100ms(50);              // delay 5 sec at 50 MHz
	if(chose_col==0&turn==0){
 Nokia5110_PrintBMP(13+(chose_col*8), 6, two2,1);
Nokia5110_DisplayBuffer();

}	
while(turn==0);	

 /* Nokia5110_Clear();
  Nokia5110_SetCursor(1, 1);
  Nokia5110_OutString("GAME OVER");
  Nokia5110_SetCursor(1, 2);
  Nokia5110_OutString("Nice try,");
  Nokia5110_SetCursor(1, 3);
  Nokia5110_OutString("Earthling!");
  Nokia5110_SetCursor(2, 4);
  Nokia5110_OutUDec(1234);*/
  while(1){
		 WaitForInterrupt();
		
		if(chose_col==0&&empty[5][0]==1&&turn==0){ Nokia5110_PrintBMP(13+(chose_col*8), 6, two2,5);}
			
		 Nokia5110_DisplayBuffer(); 
				if (turn==1&&mode==1)
		{
		  bor3y(row,coulmn);
			Nokia5110_DisplayBuffer(); 
				}
		if (turn==1&&mode==2)
		{
				while((UART1_FR_R&UART_FR_RXFE) == 0)clear=UART1_DR_R & ~(0xFF);
			uart=UART_InChar()-1-'0';
			player_2_add(uart);
			turn=0;
		}
  }

}
void print_board(char col, char row , int player){//print the board DUH!!


    if(player==1){
	Nokia5110_PrintBMP(13+col*8, -1+47-(row*8), two2,5);}
if(player==2){
	Nokia5110_PrintBMP(13+col*8,-1+47-(row*8), un2,5);}//12 to center and +1 to center bardo =D
		
	}
	

void player_1_add(unsigned char x){
	bool check=true;
	if(x<=6&&x>=0){
for(row=0 ;row<6; row++){

	if(empty[row][x]){
	player_1[row][x]=1;
 empty[row][x]=0;
		check=false;
	//send the current row and coulmn
		DisableInterrupts();
		print_board(x,row,1);
			result (row,x,1);
		EnableInterrupts();
	break;
	}
	
		/*if(check||row>=5){
	Nokia5110_SetCursor(1,1);
  Nokia5110_OutString("wrong move");
	
	}*/


}
}
}
void player_2_add(unsigned char x){
	bool check=true;//valid-invalid check
	if(x<=6&&x>=0){
for(row=0 ;row<6; row++){

	if(empty[row][x]){
	player_2[row][x]=1;
 empty[row][x]=0;
		check=false;//valid place
		//send the current row and coulmn
		DisableInterrupts();
		print_board(x,row,2);
			result (row,x,2);
		EnableInterrupts();
	break;}
	/*if(check||row>=5){
	Nokia5110_SetCursor(1, 1);
  Nokia5110_OutString("wrong move");
	
	}*/
	


}

}
}
void result (unsigned char row,unsigned char col,int player){

	win=0;
	
for( c=0;c<=7;c++){
	
if(player_1[c][row-col+c]==1){//diagonal right
	win++;
	if(win==4){
	//Nokia5110_PrintBMP(12, 47, grid,13);
win_mess(1);
		}
}
	else {win=0;}

}
win=0;
	if (player==1)
	{for( c=0;c<=7;c++){//check the current row
if(player_1[row][c]==1){ 
	win++;
	if(win==4){
	//Nokia5110_PrintBMP(12, 47, grid,13);
win_mess(1);
		}
}
	else {win=0;}
}
	
	win=0;
	
for(c=row+1; c>0;c--){//check the current row the +1 and -1 because C can't be less than zero
if(player_1[c-1][col]==1){
	win++;
	if(win==4){
	//Nokia5110_PrintBMP(12, 47, grid,13);
win_mess(1);
		}
}
	else {win=0;}

}

	win=0;
	
for( c=0;c<7;c++){//diagonal left
	
if(player_1[c][col+row-c]==1){
	win++;
	if(win==4){
win_mess(1);//Nokia5110_PrintBMP(12, 47, grid,13);
//player won
		}
}
	else {win=0;}


}
}
	else
	{
		for( c=0;c<=7;c++){//check the current row
if(player_2[row][c]==1){
	win++;
	if(win==4){
	//Nokia5110_PrintBMP(12, 47, grid,13);
win_mess(2);
		}
}
	else {win=0;}
}
	
	win=0;
	
for(c=row+1; c>0;c--){//check the current row the +1 and -1 because C can't be less than zero
if(player_2[c-1][col]==1){
	win++;
	if(win==4){
	//Nokia5110_PrintBMP(12, 47, grid,13);
win_mess(2);
		}
}
	else {win=0;}

}
	win=0;
	
for( c=0;c<=7;c++){
	
if(player_2[c][row-col+c]==1){//diagonal right
	win++;
	if(win==4){
	//Nokia5110_PrintBMP(12, 47, grid,13);
win_mess(2);
		}
}
	else {win=0;}

}
	win=0;
	
for( c=0;c<7;c++){//diagonal left
	
if(player_2[c][col+row-c]==1){
	win++;
	if(win==4){
win_mess(2);//Nokia5110_PrintBMP(12, 47, grid,13);
//player won
		}
}
	else {win=0;}


}
	}
}
void bor3y (unsigned char row,unsigned char col){//the glorious AI
		win=0;
	
	last_play=col_check;
	for(c=row+1; c>0;c--){//bor3y try to win by coulmn
if(player_2[c-1][last_play]==1){
	win++;

	if(win==3&&col<7){
	player_2_add(col_check=col);
			turn=0;//Nokia5110_PrintBMP(12, 47, grid,13);
return;
		}
}
	else {
		
			win=0;}

}
	win=0;
for(c=row+1; c>0;c--){//check the coulmn the +1 and -1 because C can't be less than zero cause unsigend and for space concern
if(player_1[c-1][col]==1){
	win++;

	if(win==3&&col<7){
	player_2_add(col_check=col);
			turn=0;//Nokia5110_PrintBMP(12, 47, grid,13);
return;
		}
}
	else {
		
			win=0;}

}



safe=0;
for ( row_check = 0; row_check<=5; row_check++){// row  handling
win=0;
if(safe>=5){
break;}
else{
safe=0;}
  for ( col_check = 0; col_check <= 6; col_check++){
   //check the current row
if(player_1[row_check][col_check]==1){
	win++;
	if(safe==1){
	win_rod++;}
	if(safe==1&&empty[row_check][rod]==1&&empty[row_check-1][rod]!=1&&win_rod==4){
	player_2_add(col_check=rod);
	turn=0;
		return;
	
	}
	
	if(win==3&&empty[row_check][col_check+1]==1&&empty[row_check-1][col_check+1]==0){
	player_2_add(col_check=col_check+1);
			turn=0;
		return;
			}
	if(win==3&&empty[row_check][rod]==1&&empty[row_check-1][rod]!=1&&safe==3){
	player_2_add(col_check=rod);
			turn=0;
		return;
			}
}
	else {
		if(win>0){
		safe++;
		win_rod=win+1;
		rod=col_check;}
		if((win==0&&safe==0)||(win==0&&safe==1)){
			safe=3;
		rod=col_check;
		continue;
		}
		if(safe>=2||player_2[row_check][col_check]==1){//the ai alredy handeled that play or two empty space
			win=0;
			win_rod=0;
		safe=0;
		rod=0;}
	}
}}

safe=0;
for ( row_check = 0; row_check<=5; row_check++){//specific  row  handling
win=0;
if(safe>=4){
break;}
else{
safe=0;}
  for ( col_check = 0; col_check <= 6; col_check++){
   //check the current row
if(player_1[row_check][col_check]==1){
	win++;
	if(safe==1&&empty[row_check][col_check-1]==1&&empty[row_check-1][col_check-1]==0){
	player_2_add(col_check-1);
	turn=0;
		return;
	
	}
	safe=0;
	if(win==3&&empty[row_check][col_check+1]==1&&empty[row_check-1][col_check+1]==0){
	player_2_add(col_check+1);
			turn=0;
		return;
			}
}
	else {safe++;
		if(safe<=2||player_2[row_check][col_check]==1)//the ai alredy handeled that play or two empty space
			win=0;
	}
}}

safe=0;

for ( row_check = 0; row_check<=5; row_check++){//bor3y playing row
win=0;
	rod=0;
if(safe>=4){
break;}
else{
safe=0;}
  for ( col_check = 0; col_check <= 6; col_check++){
   //check the current row
if(player_2[row_check][col_check]==1){
	win++;
	
	if(safe==1){
	win_rod++;}
	
	if(safe==1&&empty[row_check][rod]==1&&empty[row_check-1][rod]!=1&&win_rod==4){
	player_2_add(col_check=rod);
	turn=0;
		return;
	
	}
	
	if(win==3&&empty[row_check][col_check+1]==1&&empty[row_check-1][col_check+1]!=1){
	player_2_add(col_check=col_check+1);
			turn=0;
		return;
			}
	if(win==3&&empty[row_check][rod]==1&&empty[row_check-1][rod]!=1&&safe==3){
	player_2_add(col_check=rod);
			turn=0;
		return;
			}
}
	else {
		if(win>0){
		safe++;
		win_rod=win+1;
		rod=col_check;}
		if((win==0&&safe==0)||(win==0&&safe==1)){
		rod=col_check;
		continue;}
		if(safe>=2){//the ai alredy handeled that play or two empty space
			win=0;
			win_rod=0;
		safe=0;
		rod=0;}}
	}
}
/*
win=0;
for( c=0;c<=7;c++){
	
if(player_2[c][row-col+c]==1){//diagonal right
	win++;
	safe=0;
	if(win==3&&empty[row][col+1]==1&&empty[row][col]!=1){
		player_2_add(col_check=col+1);
			turn=0;
		//Nokia5110_PrintBMP(12, 47, grid,13);
return;
	
		}
}
	else {
	safe++;
	if(safe==2)
	win=0;}

}*/
win=0;
	
for ( col_check = 0; col_check<=3; col_check++){// right diagonal  handling

	win=0;

safe=0;
  for ( row_check = 0; row_check <= 6; row_check++){//(0,0),(0,1),(0,2),(0,3) diagonals check

if(player_1[row_check][col_check+row_check]==1){
	win++;
	if(safe==1&&empty[row_check-1][row_check+col_check-1]==1){
	player_2_add(col_check=col_check-1);
	turn=0;
		return;
	
	}
	safe=0;
	if(win==3&&empty[row_check+1][row_check+col_check+1]==1&&empty[row_check][row_check+col_check+1]==0){
	player_2_add(col_check=col_check+1);
			turn=0;
		return;
			}
}
	else {safe++;
		if(safe==2||player_2[row_check][row_check+col_check]==1)//bor3y alredy handeled that play or two empty space
			win=0;
		if(safe==3)//diagonal is safe
			break;
	}
}
if(col_check>0&&col_check<3)//(1,0) and (2,0) diagonals check
{
win=0;

safe=0;
  for ( row_check = 0; row_check <= 6; row_check++){
   //check the current row
if(player_1[col_check+row_check][row_check]==1){
	win++;
	if(safe==1&&empty[row_check+col_check-1][row_check-1]==1){
	player_2_add(col_check=col_check-1);
	turn=0;
		return;
	
	}
	safe=0;
	if(win==3&&empty[row_check+col_check+1][row_check+1]==1&&empty[row_check+col_check][row_check]==0){
	player_2_add(col_check=col_check+1);
			turn=0;
		return;
			}
}
	else {safe++;
		if(safe==2||player_2[row_check+col_check][row_check]==1)//bor3y alredy handeled that play or two empty space
			win=0;
		if(safe==3)//diagonal is safe
			break;
	}
}

}
}
win=0;
	
for ( col_check = 3; col_check<=6; col_check++){// left diagonal  handling

	win=0;

safe=0;
  for ( row_check = 0; row_check <= col_check; row_check++){

if(player_1[row_check][col_check-row_check]==1){
	win++;
	if(safe==1&&empty[row_check-1][col_check-row_check+1]==1){
	player_2_add(col_check=col_check-1);
	turn=0;
		return;
	
	}
	safe=0;
	if(win==3&&empty[row_check+1][col_check-row_check-1]==1&&empty[row_check][col_check-row_check-1]==0){
	player_2_add(col_check=col_check-1);
			turn=0;
		return;
			}
}
	else {safe++;
		if(safe==2||player_2[row_check][row_check+col_check]==1)//bor3y alredy handeled that play or two empty space
			win=0;
		if(safe==3)//diagonal is safe
			break;
	}
}

}
/*for( c=0;c<=6;c++){
if(empty[row][c]==1){
player_2_add(c);
	turn=0;
return;}
*/
safe=0;



	for(c=row+1; c>0;c--){//bor3y try to win by coulmn
if(player_2[c-1][col_check]==1){
	win++;

	if(win==2&&col<7){
	player_2_add(col_check=col);
			turn=0;//Nokia5110_PrintBMP(12, 47, grid,13);
return;
		}
}
	else {
		
			win=0;}

}

{

	srand(seed);
	
	c=rand()%6;
	
player_2_add(col_check=c);
		seed++;
	turn=0;
return;
}
}

// You can use this timer only if you learn how it works
void Timer2_Init(unsigned long period){ 
  unsigned long volatile delay;
  SYSCTL_RCGCTIMER_R |= 0x04;   // 0) activate timer2
  delay = SYSCTL_RCGCTIMER_R;
  TimerCount = 0;
  Semaphore = 0;
  TIMER2_CTL_R = 0x00000000;    // 1) disable timer2A during setup
  TIMER2_CFG_R = 0x00000000;    // 2) configure for 32-bit mode
  TIMER2_TAMR_R = 0x00000002;   // 3) configure for periodic mode, default down-count settings
  TIMER2_TAILR_R = period-1;    // 4) reload value
  TIMER2_TAPR_R = 0;            // 5) bus clock resolution
  TIMER2_ICR_R = 0x00000001;    // 6) clear timer2A timeout flag
  TIMER2_IMR_R = 0x00000001;    // 7) arm timeout interrupt
  NVIC_PRI5_R = (NVIC_PRI5_R&0x00FFFFFF)|0x80000000; // 8) priority 4
// interrupts enabled in the main program after all devices initialized
// vector number 39, interrupt number 23
  NVIC_EN0_R = 1<<23;           // 9) enable IRQ 23 in NVIC
  TIMER2_CTL_R = 0x00000001;    // 10) enable timer2A
}
void Timer2A_Handler(void){ 
  TIMER2_ICR_R = 0x00000001;   // acknowledge timer2A timeout
  TimerCount++;
  Semaphore = 1; // trigger
}
void Delay100ms(unsigned long count){unsigned long volatile time;
  while(count>0){
    time = 727240;  // 0.1sec at 80 MHz
    while(time){
	  	time--;
    }
    count--;
  }
}
void win_mess(int player)
{
	DisableInterrupts();
	Nokia5110_DisplayBuffer();
	Delay100ms(50);
Nokia5110_ClearBuffer();	 
	Nokia5110_DisplayBuffer();
  Nokia5110_SetCursor(0,0);
	if (player==1){
		
		
		 Nokia5110_OutString("  You win");
	}
	else
		Nokia5110_OutString("  You lose");
	while(1);
}
void UART_Init(void){
// as part of Lab 11, modify this program to use UART1 instead of UART1
//                 switching from PC5,PC4 to PB1,PB0
  SYSCTL_RCGC1_R |= SYSCTL_RCGC1_UART1; // activate UART1
  SYSCTL_RCGC2_R |= SYSCTL_RCGC2_GPIOB; // activate port B
  UART1_CTL_R &= ~UART_CTL_UARTEN;      // disable UART
  UART1_IBRD_R = 43;                    // IBRD = int(80,000,000 / (16 * 115200)) = int(43.402778)
  UART1_FBRD_R = 26;                    // FBRD = round(0.402778 * 64) = 26
                                        // 8 bit word length (no parity bits, one stop bit, FIFOs)
  UART1_LCRH_R = (UART_LCRH_WLEN_8|UART_LCRH_FEN);
  UART1_CTL_R |= (1<<9) | (1<<8);
	
  GPIO_PORTB_AFSEL_R |= 0x03;           // enable alt funct on PB1,PB0
  GPIO_PORTB_DEN_R |= 0x03;             // enable digital I/O on PB1,PB0
                                        // configure PB1,PB0 as UART1
  GPIO_PORTB_PCTL_R = 0x00000011;
  GPIO_PORTB_AMSEL_R &= ~0x03;          // disable analog functionality on PB1,PB0
	UART1_CTL_R |= UART_CTL_UARTEN;       // enable UART
	while((UART1_FR_R&UART_FR_RXFE) == 0)clear=UART1_DR_R & ~(0xFF);
}

unsigned char UART_InChar(void){
// as part of Lab 11, modify this program to use UART1 instead of UART1
  while((UART1_FR_R&UART_FR_RXFE) != 0);
  return((unsigned char)(UART1_DR_R&0xFF));
}

//------------UART_OutChar------------
// Output 8-bit to serial port
// Input: letter is an 8-bit ASCII character to be transferred
// Output: none
void UART_OutChar(unsigned char data){
// as part of Lab 11, modify this program to use UART1 instead of UART1
  while((UART1_FR_R&UART_FR_TXFF) != 0);
  UART1_DR_R = data;
}
